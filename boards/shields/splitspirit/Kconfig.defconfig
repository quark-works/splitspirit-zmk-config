## boards/shields/splitspirit/Kconfig.defconfig
```kconfig
# Copyright (c) 2026 The ZMK Contributors
# SPDX-License-Identifier: MIT

if SPLITSPIRIT_LEFT

config ZMK_KEYBOARD_NAME
    default "Splitspirit"
    
config ZMK_SPLIT_ROLE_CENTRAL
    default y

endif

if SPLITSPIRIT_LEFT || SPLITSPIRIT_RIGHT

config ZMK_SPLIT
    default y

endif
```

## boards/shields/splitspirit/Kconfig.shield
```kconfig
# Copyright (c) 2022 The ZMK Contributors
# SPDX-License-Identifier: MIT

config SPLITSPIRIT_LEFT
    def_bool $(shields_list_contains,splitspirit_left)

config SPLITSPIRIT_RIGHT
    def_bool $(shields_list_contains,splitspirit_right)
```
